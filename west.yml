## west.yml
```yaml
manifest:
  remotes:
    - name: zephyrproject-rtos
      url-base: https://github.com/zephyrproject-rtos

  projects:
    - name: zephyr
      remote: zephyrproject-rtos
      revision: main
      import:
        name-allowlist:
          - hal_espressif
          - mbedtls
    - name: zephyr-lang-rust
      revision: main
      path: modules/lang/rust
      remote: zephyrproject-rtos
  self:
    path: app
```
